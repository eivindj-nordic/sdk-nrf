## subsys/mpsl/Kconfig
```kconfig
#
# Copyright (c) 2019 - 2020 Nordic Semiconductor ASA
#
# SPDX-License-Identifier: LicenseRef-Nordic-5-Clause
#

menu "Multiprotocol service layer (MPSL)"

config MPSL
	bool "Nordic Multi Protocol Service Layer (MPSL)"
	select ZERO_LATENCY_IRQS if !SOC_SERIES_BSIM_NRFXX
	select IEEE802154_NRF5_EXT_IRQ_MGMT if IEEE802154_NRF5
	select NRF_802154_MULTIPROTOCOL_SUPPORT if NRF_802154_RADIO_DRIVER
	select MULTITHREADING_LOCK
	select NRF_GRTC_TIMER_AUTO_KEEP_ALIVE if NRF_GRTC_TIMER
	depends on (SOC_SERIES_BSIM_NRFXX || SOC_SERIES_NRF52 || SOC_NRF5340_CPUNET || \
		    SOC_NRF54H20_CPURAD || SOC_SERIES_NRF54L || SOC_SERIES_NRF71)
	help
	  Use Nordic Multi Protocol Service Layer (MPSL) implementation,
	  providing services for single and multi-protocol implementations.

config MPSL_FEM_ONLY
	bool "Support only radio front-end module (FEM)"
	help
	  Support only radio front-end module (FEM) feature. The MPSL library is linked
	  into a build without the initialization. Using other MPSL features is not possible.

rsource "fem/Kconfig"

if !MPSL_FEM_ONLY

rsource "cx/Kconfig"
rsource "init/Kconfig"
rsource "pin_debug/Kconfig"
rsource "pm/Kconfig"
rsource "clock_ctrl/Kconfig"

endif # !MPSL_FEM_ONLY

config MPSL_SOC_DIR
	string
	default "nrf52" if SOC_SERIES_NRF52
	default "nrf53" if SOC_NRF5340_CPUNET
	default "nrf54h" if SOC_NRF54H20_CPURAD
	default "nrf54ls" if SOC_NRF54LS05B
	default "nrf54lm_ns" if (SOC_NRF54LM20A || SOC_NRF54LM20B) && TRUSTED_EXECUTION_NONSECURE
	default "nrf54lm" if (SOC_NRF54LM20A || SOC_NRF54LM20B) && !TRUSTED_EXECUTION_NONSECURE
	default "nrf54lv_ns" if SOC_NRF54LV10A && TRUSTED_EXECUTION_NONSECURE
	default "nrf54lv" if SOC_NRF54LV10A && !TRUSTED_EXECUTION_NONSECURE
	default "nrf54l_ns" if SOC_SERIES_NRF54L && TRUSTED_EXECUTION_NONSECURE
	default "nrf54l" if SOC_SERIES_NRF54L && !TRUSTED_EXECUTION_NONSECURE
	default "nrf71" if SOC_SERIES_NRF71
	default "nrf52_bsim" if SOC_SERIES_BSIM_NRF52X
	default "nrf53_bsim" if SOC_SERIES_BSIM_NRF53X
	default "nrf54l_bsim" if SOC_SERIES_BSIM_NRF54LX
	help
	  Hidden helper option to calculate the library path

config MPSL_FLOAT_ABI_DIR
	string
	default "hard-float" if FPU && FP_HARDABI
	default "softfp-float" if FPU && FP_SOFTABI
	default "soft-float"
	help
	  Hidden helper option to calculate the library path

endmenu
```
